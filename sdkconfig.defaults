## sdkconfig.defaults
```kconfig
# CPU
CONFIG_ESP32_DEFAULT_CPU_FREQ_240=y
CONFIG_ESP32_DEFAULT_CPU_FREQ_MHZ=240
CONFIG_FREERTOS_UNICORE=y

# Disable Bluetooth
CONFIG_BT_ENABLED=n
CONFIG_BLUEDROID_ENABLED=n
CONFIG_BTDM_CTRL_ENABLED=n

# Watchdog
CONFIG_ESP_TASK_WDT=n
CONFIG_ESP_TASK_WDT_PANIC=n

# FreeRTOS tick
CONFIG_FREERTOS_HZ=1000

# Logging
CONFIG_LOG_DEFAULT_LEVEL=3
CONFIG_LOG_MAXIMUM_LEVEL=3

# Ethernet
CONFIG_ETH_ENABLED=n
CONFIG_ETH_USE_ESP32_EMAC=n
CONFIG_ETH_USE_SPI_ETHERNET=n

# CoAP
CONFIG_COAP_MBEDTLS_PSK=n

# HTTP Client
CONFIG_ESP_HTTP_CLIENT_ENABLE_HTTPS=n

# Wifi
CONFIG_ESP32_WIFI_ENABLED=n

# Arduino compatibility
CONFIG_AUTOSTART_ARDUINO=y
```
